## main/Kconfig.projbuild
```kconfig
menu "Moisture"

    config ESP_WIFI_SSID
        string "WiFi SSID"
        default ""
        help
            SSID (network name) for the example to connect to.

    config ESP_WIFI_PASSWORD
        string "WiFi Password"
        default ""
        help
            WiFi password (WPA or WPA2) for the example to use.

    config ESP_MAXIMUM_RETRY
        int "Maximum retry"
        default 5
        help
            Set the Maximum retry to avoid station reconnecting to the AP unlimited when the AP is really inexistent.

    config BROKER_URL
        string "Broker url"
        default ""
        help
            The broker url for tcp connections to a mqtt broker with port.

    config MQTT_USER
        string "MQTT username"
        default ""
        help
            The username to be used for the mqtt session.

    config MQTT_PASS
        string "MQTT user password"
        default ""
        help
            The password for the MQTT_USER

    config TOPIC
        string "MQTT topic"
        default "moisture"
        help
            The topic, where the messages are sent to

    config SENSORID
        int "The id of the sensor"
        default 1
        help
            The id of the sensor as numerical value
endmenu
```
